## drivers/platform/oppo/Kconfig
```kconfig
# OPPO configuration options

config MACH_OPPO
	bool "OPPO device"
	depends on ARCH_MSM
	help
	  Support for OPPO products

config MACH_OPPO_MSM8940
	bool "OPPO MSM8996"
	depends on ARCH_MSM8940
	select MACH_OPPO
	help
	  Support for MSM8940 OPPO variants
	  
config MACH_OPPO_MSM8953
	bool "OPPO MSM8996"
	depends on ARCH_MSM8953
	select MACH_OPPO
	help
	  Support for MSM8953 OPPO variants

menu "OPPO board selection"

config MACH_16061
	bool "A57 board"
	select MACH_OPPO_MSM8940
	help
	  Support for A57 variants
	  
config MACH_16017
	bool "R9s board"
	select MACH_OPPO_MSM8953
	help
	  Support for R9s variants

endmenu
```

## drivers/soc/oppo/Kconfig
```kconfig
menu "OPPO specific options"

config OPPO_DEVICE_INFO
	bool "OPPO device info driver"
	default y if MACH_OPPO
	help
	  Say Y to enable OPPO device info driver

config OPPO_FP_COMMON
	bool "OPPO fingerprint compatibility driver"
	default y if MACH_OPPO
	help
	  Say Y to enable OPPO fingerprint compatibility driver

endmenu
```
