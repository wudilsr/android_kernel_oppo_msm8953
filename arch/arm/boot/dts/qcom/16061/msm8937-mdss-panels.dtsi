/* Copyright (c) 2015-2017, The Linux Foundation. All rights reserved.
 *
 * This program is free software; you can redistribute it and/or modify
 * it under the terms of the GNU General Public License version 2 and
 * only version 2 as published by the Free Software Foundation.
 *
 * This program is distributed in the hope that it will be useful,
 * but WITHOUT ANY WARRANTY; without even the implied warranty of
 * MERCHANTABILITY or FITNESS FOR A PARTICULAR PURPOSE.  See the
 * GNU General Public License for more details.
 */

#include "dsi-panel-oppo16061tianma_hx8394f_720p_video.dtsi"
#include "dsi-panel-oppo16061boe_hx8394f_720p_video.dtsi"
#include "dsi-panel-oppo16061truly_hx8394f_720p_video.dtsi"
#include "dsi-panel-oppo16061boe_nt35521s_720p_video.dtsi"
#include "dsi-panel-oppo16061boe_nt35521s_b8_720p_video.dtsi"
#include "dsi-panel-dsi-panel-oppo16061truly_nt35521s_720p_video.dtsi"
#include "dsi-panel-oppo16061truly_hx8394f_new_720p_video.dtsi"

&soc {
	dsi_panel_pwr_supply: dsi_panel_pwr_supply {
		#address-cells = <1>;
		#size-cells = <0>;

		qcom,panel-supply-entry@0 {
			reg = <0>;
			qcom,supply-name = "vdd";
			qcom,supply-min-voltage = <2850000>;
			qcom,supply-max-voltage = <2850000>;
			qcom,supply-enable-load = <100000>;
			qcom,supply-disable-load = <100>;
		};

		qcom,panel-supply-entry@1 {
			reg = <1>;
			qcom,supply-name = "vddio";
			qcom,supply-min-voltage = <1800000>;
			qcom,supply-max-voltage = <1800000>;
			qcom,supply-enable-load = <100000>;
			qcom,supply-disable-load = <100>;
		};

	};
};
