/*
 * Copyright (c) 2015-2016, The Linux Foundation. All rights reserved.
 *
 * This program is free software; you can redistribute it and/or modify
 * it under the terms of the GNU General Public License version 2 and
 * only version 2 as published by the Free Software Foundation.
 *
 * This program is distributed in the hope that it will be useful,
 * but WITHOUT ANY WARRANTY; without even the implied warranty of
 * MERCHANTABILITY or FITNESS FOR A PARTICULAR PURPOSE.  See the
 * GNU General Public License for more details.
 */

&int_codec {
	/delete-property/ qcom,cdc-us-euro-gpios;
	/delete-property/ qcom,hdmi-dba-codec-rx;
	/delete-property/ pinctrl-2;
	/delete-property/ pinctrl-3;
	/delete-property/ pinctrl-4;
	/delete-property/ pinctrl-5;
	/delete-property/ pinctrl-6;
	/delete-property/ pinctrl-7;

	qcom,msm-mbhc-hphl-swh = <1>;
	qcom,msm-hs-micbias-type = "external";
	qcom,msm-micbias2-ext-cap;

	qcom,msm-gpios =
		"pri_i2s";
	qcom,pinctrl-names =
		"all_off",
		"pri_i2s_act";
	pinctrl-names =
		"all_off",
		"pri_i2s_act";
	pinctrl-0 = <&cdc_pdm_lines_sus
			&cdc_pdm_lines_2_sus>;
	pinctrl-1 = <&cdc_pdm_lines_act
			&cdc_pdm_lines_2_act>;

	asoc-codec = <&stub_codec>, <&pm8937_cajon_dig>;
	asoc-codec-names = "msm-stub-codec.1", "cajon_codec";

	oppo-spk-pa-en = <&tlmm 86 0x00>;
	oppo-spk-boost-en = <&tlmm 85 0x00>;
	oppo-hp-pa-en = <&tlmm 46 0x00>;
	oppo-hp-vdd-supply = <&pm8937_l11>;
};
